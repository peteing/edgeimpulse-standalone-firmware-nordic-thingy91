## Kconfig
```
#
# Copyright (c) 2020 Nordic Semiconductor ASA
#
# SPDX-License-Identifier: LicenseRef-Nordic-5-Clause
#

menu "MQTT Edge Impulse Demo"
config MQTT_PUB_TOPIC_PREFIX
	string "MQTT publish topic"
	default "ei/demo"

config MQTT_BROKER_HOSTNAME
	string "MQTT broker hostname"
	default "broker.hivemq.com"

config MQTT_BROKER_PORT
	int "MQTT broker port"
	default 1883

config MQTT_RECONNECT_DELAY_S
	int "Seconds to delay before attempting to reconnect to the broker."
	default 60

config LTE_CONNECT_RETRY_DELAY_S
	int "Seconds to delay before attempting to retry LTE connection."
	default 120


menu "Thingy91 App Customization"

		
	menu "Inference Settings"

		choice STANDALONE
			bool "Run Impulse Standalone"
			default STANDALONE_MODE_NONE

		config STANDALONE_MODE_BUTTON
			bool "Use Button to activate Standalone"

		config STANDALONE_MODE_AUTO
			bool "Automatically Start Impulse"

		config STANDALONE_MODE_NONE
			bool "Use CLI or AT+RUNIMPULSE over console to start Impulse (standard behaviour)"
			select STANDALONE_FIRMWARE_STANDARD

		endchoice

		config LABEL_THRESHOLD
			int "Classification threshold %"
			default 80
		
	endmenu


		choice 	MODEM_START_MODES
			bool "LTE MODEM CONNECTION"
			default  MODEM_MANUAL_CLI
		
			config MODEM_MANUAL_CLI
				bool "Start via CLI using AT+CONNECT (standard behaviour)"

			config MODEM_START_AUTO
				bool "Start Modem at startup"

			
		endchoice

	

		menu "Output Setup"
			choice LABEL_1_1
				bool "Inference LABEL 1 Primary Output (Visual)"
				default LABEL_1_1_NONE
			
			config LABEL_1_1_RED_LED
				bool "Red LED"
						
			config LABEL_1_1_MAGENTA_LED
				bool "Magenta LED"

			config LABEL_1_1_GREEN_LED
				bool "Green LED"

			config LABEL_1_1_YELLOW_LED
				bool "Yellow LED"

			config LABEL_1_1_BLUE_LED
				bool "Blue LED"
			
			config LABEL_1_1_NONE
				bool "None"
			
			endchoice

			choice LABEL_1_2
				bool "Inference LABEL 1 Secondary Output (Audio)"
				default LABEL_1_2_NONE
						
			config LABEL_1_2_BUZZER_HIGH
				bool "Buzzer High Pitch"

			config LABEL_1_2_BUZZER_MID
				bool "Buzzer Medium Pitch"

			config LABEL_1_2_BUZZER_LOW
				bool "Buzzer Low Pitch"
			
			config LABEL_1_2_NONE
				bool "None"
		
			endchoice

			choice LABEL_2_1
				bool "Inference LABEL 2 Primary Output (Visual)"
				default LABEL_2_1_NONE
			
			config LABEL_2_1_RED_LED
				bool "Red LED"
						
			config LABEL_2_1_MAGENTA_LED
				bool "Magenta LED"

			config LABEL_2_1_GREEN_LED
				bool "Green LED"

			config LABEL_2_1_YELLOW_LED
				bool "Yellow LED"

			config LABEL_2_1_BLUE_LED
				bool "Blue LED"
			
			config LABEL_2_1_NONE
				bool "None"
			
			endchoice

			choice LABEL_2_2
				bool "Inference LABEL 2 Secondary Output (Audio)"
				default LABEL_2_2_NONE
						
			config LABEL_2_2_BUZZER_HIGH
				bool "Buzzer High Pitch"

			config LABEL_2_2_BUZZER_MID
				bool "Buzzer Medium Pitch"

			config LABEL_2_2_BUZZER_LOW
				bool "Buzzer Low Pitch"
			
			config LABEL_2_2_NONE
				bool "None"
		
			endchoice
			
			choice LABEL_3_1
				bool "Inference LABEL 3 Primary Output (Visual)"
				default LABEL_3_1_NONE
			
			config LABEL_3_1_RED_LED
				bool "Red LED"
						
			config LABEL_3_1_MAGENTA_LED
				bool "Magenta LED"

			config LABEL_3_1_GREEN_LED
				bool "Green LED"

			config LABEL_3_1_YELLOW_LED
				bool "Yellow LED"

			config LABEL_3_1_BLUE_LED
				bool "Blue LED"
			
			config LABEL_3_1_NONE
				bool "None"
			
			endchoice

			choice LABEL_3_2
				bool "Inference LABEL 3 Secondary Output (Audio)"
				default LABEL_3_2_NONE
						
			config LABEL_3_2_BUZZER_HIGH
				bool "Buzzer High Pitch"

			config LABEL_3_2_BUZZER_MID
				bool "Buzzer Medium Pitch"

			config LABEL_3_2_BUZZER_LOW
				bool "Buzzer Low Pitch"
			
			config LABEL_3_2_NONE
				bool "None"
		
			endchoice

			choice LABEL_4_1
				bool "Inference LABEL 4 Primary Output (Visual)"
				default LABEL_4_1_NONE
			
			config LABEL_4_1_RED_LED
				bool "Red LED"
						
			config LABEL_4_1_MAGENTA_LED
				bool "Magenta LED"

			config LABEL_4_1_GREEN_LED
				bool "Green LED"

			config LABEL_4_1_YELLOW_LED
				bool "Yellow LED"

			config LABEL_4_1_BLUE_LED
				bool "Blue LED"
			
			config LABEL_4_1_NONE
				bool "None"
			
			endchoice

			choice LABEL_4_2
				bool "Inference LABEL 4 Secondary Output (Audio)"
				default LABEL_4_2_NONE
						
			config LABEL_4_2_BUZZER_HIGH
				bool "Buzzer High Pitch"

			config LABEL_4_2_BUZZER_MID
				bool "Buzzer Medium Pitch"

			config LABEL_4_2_BUZZER_LOW
				bool "Buzzer Low Pitch"
			
			config LABEL_4_2_NONE
				bool "None"
		
			endchoice
		
			choice LABEL_5_1
				bool "Inference LABEL 5 Primary Output (Visual)"
				default LABEL_5_1_NONE
			
			config LABEL_5_1_RED_LED
				bool "Red LED"
						
			config LABEL_5_1_MAGENTA_LED
				bool "Magenta LED"

			config LABEL_5_1_GREEN_LED
				bool "Green LED"

			config LABEL_5_1_YELLOW_LED
				bool "Yellow LED"

			config LABEL_5_1_BLUE_LED
				bool "Blue LED"
			
			config LABEL_5_1_NONE
				bool "None"
			
			endchoice

			choice LABEL_5_2
				bool "Inference LABEL 5 Secondary Output (Audio)"
				default LABEL_5_2_NONE
						
			config LABEL_5_2_BUZZER_HIGH
				bool "Buzzer High Pitch"

			config LABEL_5_2_BUZZER_MID
				bool "Buzzer Medium Pitch"

			config LABEL_5_2_BUZZER_LOW
				bool "Buzzer Low Pitch"
			
			config LABEL_5_2_NONE
				bool "None"
		
			endchoice


		endmenu

	endmenu

endmenu




config EI_INFERENCE_THREAD_STACK
	int "Inference thread stack size"
	default 4096
	help
	  "Set the Edge Impulse inference thread stack size."

config EI_INFERENCE_THREAD_PRIO
	int "Inference thread priority"
	default 5
	help
	  "Set the Edge Impulse inference thread priority. The lower number, the higher prority."


menu "Zephyr Kernel"
source "Kconfig.zephyr"
endmenu

module = MQTT_EI_DEMO
module-str = MQTT Edge Impulse Demo
source "${ZEPHYR_BASE}/subsys/logging/Kconfig.template.log_config"
```

## prj.conf
```kconfig
CONFIG_GPIO=y
# enable c++ support
CONFIG_CPLUSPLUS=y
CONFIG_LIB_CPLUSPLUS=y
CONFIG_NEWLIB_LIBC=y
CONFIG_NEWLIB_LIBC_FLOAT_PRINTF=y

# enable reboot from user space
CONFIG_REBOOT=y
CONFIG_FPU=y
CONFIG_MAIN_STACK_SIZE=8192

# Buzzer PWM
CONFIG_PWM=y

CONFIG_LTE_NETWORK_MODE_NBIOT=y

# serial console
CONFIG_SERIAL=y
CONFIG_UART_INTERRUPT_DRIVEN=y
CONFIG_CONSOLE_SUBSYS=n
CONFIG_CONSOLE_GETCHAR=n

# Buses configuration
CONFIG_I2C=y
CONFIG_I2C_NRFX=y
CONFIG_SPI=y

# Modem info
CONFIG_HEAP_MEM_POOL_SIZE=4096
CONFIG_AT_CMD=y

# Logging
CONFIG_ASSERT=y
CONFIG_DEBUG=n
CONFIG_LOG=n
# CONFIG_LOG_MODE_DEFERRED=y
# CONFIG_LOG_BACKEND_UART=n
# CONFIG_LOG_BACKEND_RTT=y
# CONFIG_LOG_STRDUP_MAX_STRING=1024
# CONFIG_NCS_SAMPLES_DEFAULTS=n
# CONFIG_ASSERT_NO_COND_INFO=y
# CONFIG_ASSERT_NO_MSG_INFO=y
# CONFIG_HW_STACK_PROTECTION=y
# CONFIG_USE_SEGGER_RTT=y
# CONFIG_SEGGER_RTT_BUFFER_SIZE_UP=4096

# Networking
CONFIG_NETWORKING=y
CONFIG_NET_SOCKETS=y
CONFIG_MODEM_INFO=y
CONFIG_NET_NATIVE=n
CONFIG_NET_SOCKETS_OFFLOAD=y
CONFIG_NET_SOCKETS_POSIX_NAMES=y

# LTE link control
CONFIG_LTE_LINK_CONTROL=y
CONFIG_LTE_AUTO_INIT_AND_CONNECT=n

# Modem library
CONFIG_NRF_MODEM_LIB=y

# AT Host
# CONFIG_AT_HOST_LIBRARY=y

# MQTT
CONFIG_MQTT_LIB=y
CONFIG_MQTT_LIB_TLS=n
CONFIG_MQTT_CLEAN_SESSION=y

CONFIG_NRF_MODEM_LIB_SYS_INIT=n
# CONFIG_MODEM_KEY_MGMT=y

# Accelerometer driver
CONFIG_SENSOR=y
CONFIG_ADXL362=y
CONFIG_ADXL362_ACCEL_RANGE_2G=y
CONFIG_ADXL362_ACCEL_ODR_400=y

CONFIG_BH1749=y

# Flash - Used in FOTA, settings and storage for P-GPS.
CONFIG_FLASH=y
CONFIG_FLASH_PAGE_LAYOUT=y
CONFIG_FLASH_MAP=y
CONFIG_STREAM_FLASH=y
CONFIG_MPU_ALLOW_FLASH_WRITE=y

# Bootloader
CONFIG_BOOTLOADER_MCUBOOT=y
CONFIG_MCUBOOT_IMG_MANAGER=y
CONFIG_IMG_MANAGER=y
CONFIG_IMG_ERASE_PROGRESSIVELY=y
```

## src/main.cpp
```c
#include <zephyr.h>
//#include "ei_run_classifier.h"
#include "numpy.hpp"
#include <sys/printk.h>
#include "ei_device_nordic_nrf91.h"
#include "ei_zephyr_flash_commands.h"
#include "ei_main.h"




int main(void)
{
   
    /* This is needed so that output of printf 
       is output immediately without buffering 
    */
    setvbuf(stdout, NULL, _IONBF, 0);

    /* Initialize board uart */
    if(uart_init() != 0){
        ei_printf("Init uart on board error occured\r\n");
    }

    /** Initialize development board LEDs */
    if(BOARD_ledInit() != 0){
        ei_printf("Init LEDs on board error occured\r\n");
    }

    /* Custom Additions for Buzzer and Button input */

    if(BOARD_buzInit()!=0){

        ei_printf("Init Buzzer on board error occured\r\n");
    }

    if(BOARD_btnInit() !=0){

        ei_printf("Init SW3 on board error occured\r\n");


    }

    /* Initialize Edge Impulse sensors and commands */
    ei_init();


    while(1){
     
     

    ei_main();
    }
}
```
